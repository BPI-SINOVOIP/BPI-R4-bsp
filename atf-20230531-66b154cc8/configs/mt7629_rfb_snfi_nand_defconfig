## atf-20230531-66b154cc8/configs/mt7629_rfb_snfi_nand_defconfig
```kconfig
CONFIG_PLAT_MT7629=y
CONFIG_TARGET_ALL_NO_SEC_BOOT=y
# CONFIG_ENABLE_JTAG is not set
```

## atf-20230531-66b154cc8/configs/mt7981_rfb_spim_nand_defconfig
```kconfig
CONFIG_PLAT_MT7981=y
CONFIG_TARGET_ALL_NO_SEC_BOOT=y
CONFIG_FLASH_DEVICE_SPIM_NAND=y
CONFIG_MT7981_BGA=y
# CONFIG_ENABLE_JTAG is not set
```

## atf-20230531-66b154cc8/configs/mt7988_rfb_spim_nand_defconfig
```kconfig
CONFIG_PLAT_MT7988=y
CONFIG_TARGET_ALL_NO_SEC_BOOT=y
CONFIG_FLASH_DEVICE_SPIM_NAND=y
CONFIG_NMBM=y
CONFIG_MT7988_DRAM_COMB=y
# CONFIG_ENABLE_JTAG is not set
```

## atf-20230531-66b154cc8/plat/mediatek/mt7622/config.in
```kconfig
#
# Copyright (c) 2022, MediaTek Inc. All rights reserved.
#
# SPDX-License-Identifier: BSD-3-Clause
#

menu "MT7622 DRAM"
	depends on !FPGA
	choice MT7622_DDR_TYPE
		bool "DRAM type"
		config MT7622_DRAM_DDR3
			bool "DDR3"
	endchoice
	config MT7622_DRAM_DDR3_FLYBY
		bool "Enable Fly-by topology (Uses 2x DDR3 chips)"
		default n
endmenu
```

## atf-20230531-66b154cc8/plat/mediatek/mt7629/config.in
```kconfig
#
# Copyright (c) 2022, MediaTek Inc. All rights reserved.
#
# SPDX-License-Identifier: BSD-3-Clause
#

menu "MT7629 DRAM"
	depends on !FPGA
	choice MT7629_DDR_TYPE
		bool "DRAM type"
		config MT7629_DRAM_DDR3
			bool "DDR3"
	endchoice
endmenu
```

## atf-20230531-66b154cc8/plat/mediatek/mt7981/config.in
```kconfig
#
# Copyright (c) 2022, MediaTek Inc. All rights reserved.
#
# SPDX-License-Identifier: BSD-3-Clause
#

menu "MT7981 DRAM"
	depends on !FPGA
	choice MT7981_DDR_TYPE
		bool "MT7981_DRAM type"
		config MT7981_DRAM_DDR3
			bool "DDR3"
		config MT7981_DRAM_DDR4
			bool "DDR4"
	endchoice
	choice MT7981_BOARD_TYPE
		bool "BOARD type"
		config MT7981_QFN
			bool "QFN"
			depends on MT7981_DRAM_DDR3
		config MT7981_BGA
			bool "BGA"
	endchoice
	choice MT7981_DDR_SIZE
		bool "MT7981_DRAM size limitation"
		default MT7981_DRAM_SIZE_AUTO
		config MT7981_DRAM_SIZE_AUTO
			bool "Auto detect"
		config MT7981_DRAM_SIZE_256
			bool "256MB"
			depends on MT7981_DRAM_DDR3
		config MT7981_DRAM_SIZE_512
			bool "512MB"
			depends on MT7981_DRAM_DDR3
		config MT7981_DRAM_SIZE_1024
			bool "1GB"
			depends on MT7981_DRAM_DDR4
		config MT7981_DRAM_SIZE_2048
			bool "2GB"
			depends on MT7981_DRAM_DDR4
	endchoice
	choice MT7981_DDR3_FREQUENCY
		bool "DDR3 frequency"
		default MT7981_DDR3_FREQ_2133
		depends on MT7981_DRAM_DDR3
		config MT7981_DDR3_FREQ_2133
			bool "DDR3 2133MHz"
		config MT7981_DDR3_FREQ_1866
			bool "DDR3 1866MHz"
	endchoice
endmenu
```

## atf-20230531-66b154cc8/plat/mediatek/mt7986/config.in
```kconfig
#
# Copyright (c) 2022, MediaTek Inc. All rights reserved.
#
# SPDX-License-Identifier: BSD-3-Clause
#

menu "MT7986 DRAM"
	depends on !FPGA
	choice MT7986_DDR_TYPE
		bool "DRAM type"
		config MT7986_DRAM_DDR3
			bool "DDR3"
		config MT7986_DRAM_DDR4
			bool "DDR4"
	endchoice
	choice MT7986_DDR_SIZE
		bool "MT7986_DRAM size limitation"
		default MT7986_DRAM_SIZE_AUTO
		config MT7986_DRAM_SIZE_AUTO
			bool "Auto detect"
		config MT7986_DRAM_SIZE_256
			bool "256MB"
			depends on MT7986_DRAM_DDR3
		config MT7986_DRAM_SIZE_512
			bool "512MB"
			depends on MT7986_DRAM_DDR3
		config MT7986_DRAM_SIZE_1024
			bool "1GB"
			depends on MT7986_DRAM_DDR4
		config MT7986_DRAM_SIZE_2048
			bool "2GB"
			depends on MT7986_DRAM_DDR4
	endchoice
	choice MT7986_DDR4_FREQUENCY
		bool "DDR4 frequency"
		default MT7986_DDR4_FREQ_3200
		depends on MT7986_DRAM_DDR4
		config MT7986_DDR4_FREQ_3200
			bool "DDR4 3200MHz"
		config MT7986_DDR4_FREQ_2666
			bool "DDR4 2666MHz"
	endchoice
endmenu
```

## atf-20230531-66b154cc8/plat/mediatek/mt7988/config.in
```kconfig
#
# Copyright (c) 2022, MediaTek Inc. All rights reserved.
#
# SPDX-License-Identifier: BSD-3-Clause
#

menu "MT7988 Advanced options"
	depends on !FPGA
	config MT7988_BL2_CPU_FULL_SPEED
		bool "Enable BL2 CPU full speed mode"
		default n
endmenu

menu "MT7988 FPGA DRAM"
	depends on FPGA
	choice MT7988_FPGA_DDR_TYPE
		default MT7988_FPGA_DDR2_256M
		bool "FPGA DRAM type"
		config MT7988_FPGA_DDR2_256M
			bool "DDR2 256M"
		config MT7988_FPGA_DDR2_512M
			bool "DDR2 512M"
		config MT7988_FPGA_DDR4
			bool "DDR4"
		config MT7988_FPGA_DDR4_8GB
			bool "DDR4_8GB"
		config MT7988_FPGA_SKIP_DRAM
			bool "NO DRAM"
	endchoice
endmenu

menu "MT7988 DRAM"
	depends on !FPGA
	choice MT7988_DDR_TYPE
		bool "DRAM type"
		config MT7988_DRAM_DDR3
			bool "DDR3"
		config MT7988_DRAM_DDR4
			bool "DDR4"
		config MT7988_DRAM_SIZE_4GB
			bool "4GB"
			depends on MT7988_DRAM_DDR4
		config MT7988_DRAM_COMB
			bool "DRAM_COMB"
		config MT7988_DRAM_SIZE_8GB
			bool "8GB"
			depends on MT7988_DRAM_COMB
	endchoice

	choice MT7988_DDR3_FREQUENCY
	bool "MT7988 DDR3 frequency"
	default MT7988_DDR3_FREQ_2133
	config MT7988_DDR3_FREQ_2133
		bool "DDR3 2133 Mbps"
	config MT7988_DDR3_FREQ_1866
		bool "DDR3 1866 Mbps"
	endchoice

	choice MT7988_DDR4_FREQUENCY
	bool "MT7988 DDR4 frequency"
	default MT7988_DDR4_FREQ_3200
	config MT7988_DDR4_FREQ_3200
		bool "DDR4 3200 Mbps"
	config MT7988_DDR4_FREQ_2666
		bool "DDR4 2666 Mbps"
	endchoice

	choice MT7988_DDR_SIZE
		bool "MT7988_DRAM size limitation"
		default MT7988_DRAM_SIZE_AUTO
		config MT7988_DRAM_SIZE_AUTO
			bool "Auto detect"
		config MT7988_DRAM_SIZE_256
			bool "256MB"
			depends on MT7988_DRAM_DDR3
		config MT7988_DRAM_SIZE_512
			bool "512MB"
			depends on MT7988_DRAM_DDR3
		config MT7988_DRAM_SIZE_1024
			bool "1GB"
			depends on MT7988_DRAM_DDR4
		config MT7988_DRAM_SIZE_2048
			bool "2GB"
			depends on MT7988_DRAM_DDR4
	endchoice

endmenu
```
